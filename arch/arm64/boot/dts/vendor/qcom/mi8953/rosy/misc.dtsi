&spi_6 {
    status = "okay";
	spi_ir@1 {
	    compatible = "ifrared,spi-msm-ir-slave";
	    reg = <1>; /* Chip select 0 */
	    spi-max-frequency = <1000000>;
	    spi-cpol;
		status = "okay";
	};
};
