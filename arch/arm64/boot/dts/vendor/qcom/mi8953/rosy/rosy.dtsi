#include "../common/pinctrl.dtsi"
#include "android.dtsi"
#include "regulator.dtsi"
#include "display.dtsi"
#include "rosy-qrd.dtsi"
#include "touchscreen.dtsi"
#include "camera.dtsi"
#include "audio.dtsi"
#include "misc.dtsi"
#include "pinctrl.dtsi"
#include "fingerprint.dtsi"
#include "pmic.dtsi"
#include "battery.dtsi"