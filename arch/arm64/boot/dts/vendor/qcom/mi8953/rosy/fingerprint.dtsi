&soc {
	fpc1020 {
		compatible = "fpc,fpc1020-rosy";
		interrupt-parent = <&tlmm>;
		interrupts = <48 0x0>;
		fpc,gpio_rst    = <&tlmm 140 0>;
		fpc,gpio_irq    = <&tlmm 48 0>;
		fpc,gpio_pwr   = <&tlmm 134 0>;
		vcc_spi-supply  = <&pm8953_l5>;
		vdd_ana-supply  = <&pm8953_l5>;
		vdd_io-supply   = <&pm8953_l5>;
		fpc,enable-on-boot;
		/delete-property/ fpc,enable-wakeup;
		fpc,spi-max-frequency = <4800000>;
		/* Only for SPI Clock Handled by Linux */
		clock-names = "iface_clk", "core_clk";
		clocks = <&clock_gcc clk_gcc_blsp1_ahb_clk>,
				<&clock_gcc clk_gcc_blsp1_qup1_spi_apps_clk>;
		pinctrl-names = "fpc1020_spi_active",
						"fpc1020_reset_reset",
						"fpc1020_reset_active",
						"fpc1020_irq_active";
		pinctrl-0 = <&fpc_spi_active>;
		pinctrl-1 = <&fpc_reset_reset>;
		pinctrl-2 = <&fpc_reset_active>;
		pinctrl-3 = <&fpc_irq_active>;
	};

	goodix_fp {
		compatible = "goodix,fingerprint-rosy";
		interrupt-parent = <&tlmm>;
		interrupts = <48 0x1>;
		fp-gpio-irq = <&tlmm 48 0x00>;
		fp-gpio-reset = <&tlmm 140 0x00>;
		fp-gpio-power = <&tlmm 134 0x00>;
		spi-max-frequency = <19200000>;
	};
};