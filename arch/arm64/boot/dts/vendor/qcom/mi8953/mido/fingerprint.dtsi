&soc {
	goodix_fp {
		compatible = "goodix,fingerprint-mido";
		spi-max-frequency = <1000000>;
		input-device-name = "gf3208";
		interrupt-parent = <&tlmm>;
		interrupts = <9 0x0>;

		goodix,gpio_reset    = <&tlmm 140 0>;
		goodix,gpio_irq      = <&tlmm 48 0>;
	};

	fpc1020 {
		compatible = "fpc,fpc1020-mido";
		spi-max-frequency = <1000000>;
		input-device-name = "fpc1020";
		interrupt-parent = <&tlmm>;
		interrupts = <9 0x0>;
		fpc,gpio_rst    = <&tlmm 140 0>;
		fpc,gpio_irq    = <&tlmm 48 0>;
	};
};