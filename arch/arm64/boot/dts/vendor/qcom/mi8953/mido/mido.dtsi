/ {
	reserved-memory {
		ramoops_mem: ramoops@9ff00000 {
			compatible = "ramoops";
			reg = <0x0 0x9ff00000 0x0 0x100000>;
			console-size = <0x100000>;
		};
	};
};

#include "../common/pinctrl.dtsi"
#include "display.dtsi"
#include "touchscreen.dtsi"
#include "camera.dtsi"
#include "audio.dtsi"
#include "misc.dtsi"
#include "pinctrl.dtsi"
#include "fingerprint.dtsi"
#include "pmic.dtsi"
#include "battery.dtsi"
