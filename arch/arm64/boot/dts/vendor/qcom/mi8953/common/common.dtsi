#include "android.dtsi"
#include "soc.dtsi"
#include "spi.dtsi"
#include "audio.dtsi"
#include "display.dtsi"
#include "xiaomi-common.dtsi"
#include "haptic.dtsi"
#include "regulator.dtsi"
#include "leds.dtsi"
#include "misc.dtsi"