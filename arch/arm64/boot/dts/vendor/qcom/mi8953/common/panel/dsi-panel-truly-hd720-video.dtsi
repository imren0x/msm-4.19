/* Copyright (c) 2015, The Linux Foundation. All rights reserved.
 * Copyright (C) 2019 XiaoMi, Inc.
 *
 * This program is free software; you can redistribute it and/or modify
 * it under the terms of the GNU General Public License version 2 and
 * only version 2 as published by the Free Software Foundation.
 *
 * This program is distributed in the hope that it will be useful,
 * but WITHOUT ANY WARRANTY; without even the implied warranty of
 * MERCHANTABILITY or FITNESS FOR A PARTICULAR PURPOSE.  See the
 * GNU General Public License for more details.
 */

&mdss_mdp {
	dsi_truly_hd720_vid: qcom,mdss_dsi_truly_hd720_video {
		qcom,mdss-dsi-panel-name = "truly hx8394f hd720 video mode dsi panel";
		qcom,mdss-dsi-panel-type = "dsi_video_mode";
		qcom,mdss-dsi-panel-controller = <&mdss_dsi0>;
		qcom,mdss-dsi-panel-framerate = <60>;
		qcom,mdss-dsi-virtual-channel-id = <0>;
		qcom,mdss-dsi-stream = <0>;
		qcom,mdss-dsi-panel-width = <720>;
		qcom,mdss-dsi-panel-height = <1440>;
		qcom,mdss-dsi-h-front-porch = <96>;
		qcom,mdss-dsi-h-back-porch = <80>;
		qcom,mdss-dsi-h-pulse-width = <20>;
		qcom,mdss-dsi-h-sync-skew = <0>;
		qcom,mdss-dsi-v-back-porch = <4>;
		qcom,mdss-dsi-v-front-porch = <10>;
		qcom,mdss-dsi-v-pulse-width = <4>;
		qcom,mdss-dsi-h-left-border = <0>;
		qcom,mdss-dsi-h-right-border = <0>;
		qcom,mdss-dsi-v-top-border = <0>;
		qcom,mdss-dsi-v-bottom-border = <0>;
		qcom,mdss-dsi-bpp = <24>;
		qcom,mdss-dsi-underflow-color = <0xff>;
		qcom,mdss-dsi-border-color = <0>;
		qcom,mdss-dsi-h-sync-pulse = <0>;
		qcom,mdss-pan-physical-width-dimension = <68>;
		qcom,mdss-pan-physical-height-dimension = <136>;
		qcom,mdss-dsi-traffic-mode = "burst_mode";
		qcom,mdss-dsi-bllp-eof-power-mode;
		qcom,mdss-dsi-bllp-power-mode;
		qcom,mdss-dsi-lane-0-state;
		qcom,mdss-dsi-lane-1-state;
		qcom,mdss-dsi-lane-2-state;
		qcom,mdss-dsi-lane-3-state;
		qcom,mdss-dsi-panel-timings = [8E 1E 14 00 42 46 18 20 19 03
			04 00];
		qcom,mdss-dsi-t-clk-post = <0x0a>;
		qcom,mdss-dsi-t-clk-pre = <0x1f>;
		qcom,mdss-dsi-bl-min-level = <1>;
		qcom,mdss-dsi-bl-max-level = <4095>;
		qcom,mdss-dsi-dma-trigger = "trigger_sw";
		qcom,mdss-dsi-mdp-trigger = "none";
		qcom,mdss-dsi-on-command = [
			39 01 00 00 00 00 04 B9 FF 83 94
			39 01 00 00 00 00 07 BA 63 03 68 6B B2 C0
			39 01 00 00 00 00 0B B1 48 07 67 09 31 54 71 31 50 34
			39 01 00 00 00 00 07 B2 00 80 78 06 08 22
			39 01 00 00 00 00 16 B4 71 72 29 72 29 72 01 0C 7C 33 00 3F 71 72 29 72 29 72 01 0C 7E
			39 01 00 00 00 00 3B E0 1a 1A 20 25 25 28 2B 28 52 63 72 70 77 8A 90 93 A1 A5 A0 B0 C1 61 5F 64 69 6C 72 7A 7C 1a 1A 20 24 25 28 2A 28 53 63 71 6F 77 8A 8F 94 A0 A4 A0 AF C1 60 5F 63 68 6C 73 7A 7C
			39 01 00 00 00 00 22 D3 00 00 00 00 00 00 0F 0F 32 10 01 00 01 52 15 A8 05 A8 32 10 00 00 00 67 43 05 05 37 0E 0E 27 06 40
			39 01 00 00 00 00 2D D5 19 19 18 18 24 25 06 07 04 05 02 03 00 01 18 18 18 18 18 18 18 18 18 18 18 18 18 18 18 18 20 21 18 18 18 18 18 18 18 18 18 18 18 18
			39 01 00 00 00 00 2D D6 18 18 19 19 21 20 01 00 03 02 05 04 07 06 18 18 18 18 18 18 18 18 18 18 18 18 18 18 18 18 25 24 18 18 18 18 18 18 18 18 18 18 18 18
			39 01 00 00 00 00 03 B6 25 25
			39 01 00 00 00 00 02 CC 0B
			39 01 00 00 00 00 03 C0 1F 31
			39 01 00 00 00 00 02 D4 02
			39 01 00 00 00 00 02 BD 02
			39 01 00 00 00 00 05 D3 01 04 00 01
			39 01 00 00 00 00 02 BD 00
			39 01 00 00 00 00 02 BD 01
			39 01 00 00 00 00 02 B1 00
			39 01 00 00 00 00 02 BD 00
			39 01 00 00 00 00 02 BD 02
			39 01 00 00 00 00 0D D8 FF FF FF FF FF F0 FF FF FF FF FF F0
			39 01 00 00 00 00 02 BD 00
			39 01 00 00 00 00 02 C1 00
			39 01 00 00 00 00 02 C6 ED
			15 01 00 00 00 00 02 35 00
			39 01 00 00 05 00 02 55 11
			39 01 00 00 00 00 0a ca 20 20 20 20 20 20 20 20 20
			39 01 00 00 00 00 02 51 ff
			39 01 00 00 00 00 0a c9 13 00 0a 10 b2 20 00 91 00
			39 01 00 00 00 00 02 53 2c
			05 01 00 00 78 00 02 11 00
			05 01 00 00 14 00 02 29 00
		];
		qcom,mdss-dsi-off-command = [
			05 01 00 00 24 00 02 28 00
			05 01 00 00 78 00 02 10 00
			];
		qcom,mdss-dsi-on-command-state = "dsi_lp_mode";
		qcom,mdss-dsi-off-command-state = "dsi_lp_mode";
		qcom,mdss-dsi-bl-pmic-control-type = "bl_ctrl_wled";
		qcom,mdss-dsi-reset-sequence = <1 10>, <0 10>, <1 10>;
		qcom,mdss-dsi-tx-eot-append;
		qcom,mdss-dsi-lp11-init;
		qcom,mdss-dsi-post-init-delay = <1>;

		//qcom,mdss-dsi-hbp-power-mode;
		qcom,esd-check-enabled;
		qcom,mdss-dsi-panel-status-command = [14 01 00 01 05 00 01 0a
			14 01 00 01 05 00 01 0c
			14 01 00 01 05 00 01 0d
			14 01 00 01 05 00 01 d9
			24 01 00 01 05 00 01 c9
			];
		qcom,mdss-dsi-panel-status-command-state = "dsi_hs_mode";
		qcom,mdss-dsi-panel-status-check-mode = "reg_read";
		qcom,mdss-dsi-panel-status-read-length = <1 1 1 1 2>;
		qcom,mdss-dsi-panel-status-valid-params = <1 1 1 1 2>;
		qcom,mdss-dsi-panel-status-value = <0x1c 0x77 0x00 0x80 0x13 0x00>;
		qcom,ulps-enabled;
		qcom,suspend-ulps-enabled;
	};
};

