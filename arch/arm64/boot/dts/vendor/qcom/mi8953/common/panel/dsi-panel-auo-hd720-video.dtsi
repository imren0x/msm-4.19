/* Copyright (c) 2015, The Linux Foundation. All rights reserved.
 * Copyright (C) 2019 XiaoMi, Inc.
 *
 * This program is free software; you can redistribute it and/or modify
 * it under the terms of the GNU General Public License version 2 and
 * only version 2 as published by the Free Software Foundation.
 *
 * This program is distributed in the hope that it will be useful,
 * but WITHOUT ANY WARRANTY; without even the implied warranty of
 * MERCHANTABILITY or FITNESS FOR A PARTICULAR PURPOSE.  See the
 * GNU General Public License for more details.
 */

&mdss_mdp {
	dsi_auo_hd720_vid: qcom,mdss_dsi_auo_hd720_video {
		qcom,mdss-dsi-panel-name = "auo ili7807d hd720 video mode dsi panel";
		qcom,mdss-dsi-panel-type = "dsi_video_mode";
		qcom,mdss-dsi-panel-controller = <&mdss_dsi0>;
		qcom,mdss-dsi-panel-framerate = <60>;
		qcom,mdss-dsi-virtual-channel-id = <0>;
		qcom,mdss-dsi-stream = <0>;
		qcom,mdss-dsi-panel-width = <720>;
		qcom,mdss-dsi-panel-height = <1440>;
		qcom,mdss-dsi-h-front-porch = <60>;
		qcom,mdss-dsi-h-back-porch = <344>;
		qcom,mdss-dsi-h-pulse-width = <8>;
		qcom,mdss-dsi-h-sync-skew = <0>;
		qcom,mdss-dsi-v-back-porch = <14>;
		qcom,mdss-dsi-v-front-porch = <12>;
		qcom,mdss-dsi-v-pulse-width = <2>;
		qcom,mdss-dsi-h-left-border = <0>;
		qcom,mdss-dsi-h-right-border = <0>;
		qcom,mdss-dsi-v-top-border = <0>;
		qcom,mdss-dsi-v-bottom-border = <0>;
		qcom,mdss-dsi-bpp = <24>;
		qcom,mdss-dsi-underflow-color = <0xff>;
		qcom,mdss-dsi-border-color = <0>;
		qcom,mdss-dsi-h-sync-pulse = <0>;
		qcom,mdss-pan-physical-width-dimension = <68>;
		qcom,mdss-pan-physical-height-dimension = <136>;
		qcom,mdss-dsi-traffic-mode = "burst_mode";
		qcom,mdss-dsi-bllp-eof-power-mode;
		qcom,mdss-dsi-bllp-power-mode;
		qcom,mdss-dsi-lane-0-state;
		qcom,mdss-dsi-lane-1-state;
		qcom,mdss-dsi-lane-2-state;
		qcom,mdss-dsi-lane-3-state;
		qcom,mdss-dsi-panel-timings = [79 1A 12 00 3E 42 16 1E 15 03
			04 00];
		qcom,mdss-dsi-t-clk-post = <0x0b>;
		qcom,mdss-dsi-t-clk-pre = <0x24>;
		qcom,mdss-dsi-bl-min-level = <1>;
		qcom,mdss-dsi-bl-max-level = <4095>;
		qcom,mdss-dsi-dma-trigger = "trigger_sw";
		qcom,mdss-dsi-mdp-trigger = "none";
		qcom,mdss-dsi-on-command = [
				39 01 00 00 00 00 04 ff 78 07 05
				15 00 00 00 00 00 02 00 15
				15 00 00 00 00 00 02 01 15
				15 00 00 00 00 00 02 02 15
				15 00 00 00 00 00 02 03 50
				15 00 00 00 00 00 02 04 02
				15 00 00 00 00 00 02 10 0e
				15 00 00 00 00 00 02 11 F7
				15 00 00 00 00 00 02 14 06
				15 00 00 00 00 00 02 16 17
				15 00 00 00 00 00 02 18 17
				15 00 00 00 00 00 02 1e 02
				15 00 00 00 00 00 02 20 17
				15 00 00 00 00 00 02 22 17
				39 01 00 00 00 00 04 FF 78 07 00
				39 01 00 00 00 00 03 51 0F FF
				15 01 00 00 00 00 02 53 2C
				15 01 00 00 00 00 02 55 00
				05 01 00 00 78 00 02 11 00
				05 01 00 00 0a 00 02 29 00
				05 01 00 00 00 00 02 35 00];
		qcom,mdss-dsi-off-command = [
				39 01 00 00 00 00 04 FF 78 07 00
				05 01 00 00 0a 00 02 28 00
				05 01 00 00 78 00 02 10 00
				];
		qcom,mdss-dsi-on-command-state = "dsi_lp_mode";
		qcom,mdss-dsi-off-command-state = "dsi_lp_mode";
		qcom,mdss-dsi-bl-pmic-control-type = "bl_ctrl_wled";
		qcom,mdss-dsi-reset-sequence = <1 10>, <0 10>, <1 10>;
		qcom,mdss-dsi-tx-eot-append;
		qcom,mdss-dsi-lp11-init;
		qcom,mdss-dsi-post-init-delay = <1>;

		qcom,mdss-dsi-hbp-power-mode;
		qcom,esd-check-enabled;
		qcom,mdss-dsi-panel-status-command = [06 01 00 01 05 00 01 0A];
		qcom,mdss-dsi-panel-status-command-state = "dsi_lp_mode";
		qcom,mdss-dsi-panel-status-check-mode = "reg_read";
		qcom,mdss-dsi-panel-status-read-length = <1>;
		qcom,mdss-dsi-panel-status-value = <0x9c>;
		qcom,ulps-enabled;
		qcom,suspend-ulps-enabled;
	};
};
