#include "include/aw2013.h"

/* msm8953.dtsi */
/ {
    firmware: firmware {
        android {
			/delete-node/ fstab;
            /delete-node/ vbmeta;
        };
    };
	aliases {
		spi3 = &spi_3;
		spi5 = &spi_5;
        spi6 = &spi_6;
	};
};

/* msm8953.dtsi */
&other_ext_mem {
	reg = <0x0 0x84A00000 0x0 0x1E00000>;
};

/* msm8953-pm.dtsi */
&soc {
	qcom,lpm-levels {
		qcom,use-psci;
	};
};

/* msm8953.dtsi */
&i2c_1 {
	qcom,disable-dma;
};

&i2c_2 {
	qcom,disable-dma;
};

&i2c_3 {
	qcom,disable-dma;
};

&i2c_5 {
	qcom,disable-dma;
};

/* msm8953-thermal.dtsi */
&thermal_zones {
	case-therm-adc {
		status = "disabled";
	};

	case-therm-step {
		status = "disabled";
	};

	quiet-therm-step {
		status = "disabled";
	};
};

&soc {
	restart@4ab000 {
		qcom,force-warm-reboot;
	};
};

/* msm8953.dtsi */
&soc { 
	/delete-node/ qseecom@85b00000;
	qcom_seecom: qseecom@84A00000 {
		compatible = "qcom,qseecom";
		reg = <0x84A00000 0x1900000>;
		reg-names = "secapp-region";
		qcom,hlos-num-ce-hw-instances = <1>;
		qcom,hlos-ce-hw-instance = <0>;
		qcom,qsee-ce-hw-instance = <0>;
		qcom,disk-encrypt-pipe-pair = <2>;
		qcom,support-fde;
		qcom,msm-bus,name = "qseecom-noc";
		qcom,msm-bus,num-cases = <4>;
		qcom,msm-bus,num-paths = <1>;
		qcom,support-bus-scaling;
		qcom,msm-bus,vectors-KBps =
			<55 512 0 0>,
			<55 512 0 0>,
			<55 512 120000 1200000>,
			<55 512 393600 3936000>;
		clocks = <&clock_gcc clk_crypto_clk_src>,
			 <&clock_gcc clk_gcc_crypto_clk>,
			 <&clock_gcc clk_gcc_crypto_ahb_clk>,
			 <&clock_gcc clk_gcc_crypto_axi_clk>;
		clock-names = "core_clk_src", "core_clk",
				"iface_clk", "bus_clk";
		qcom,ce-opp-freq = <100000000>;
		status = "okay";
	};
};

&soc {
    spi_3: spi@78b7000 { /* BLSP1 QUP3 */
		compatible = "qcom,spi-qup-v2";
		#address-cells = <1>;
		#size-cells = <0>;
		reg-names = "spi_physical", "spi_bam_physical";
		reg = <0x78b7000 0x600>,
			<0x7884000 0x1f000>;
		interrupt-names = "spi_irq", "spi_bam_irq";
		interrupts = <0 97 0>, <0 238 0>;
		spi-max-frequency = <19200000>;
		pinctrl-names = "spi_default", "spi_sleep";
		pinctrl-0 = <&spi3_default &spi3_cs0_active>;
		pinctrl-1 = <&spi3_sleep &spi3_cs0_sleep>;
		clocks = <&clock_gcc clk_gcc_blsp1_ahb_clk>,
			<&clock_gcc clk_gcc_blsp1_qup3_spi_apps_clk>;
		clock-names = "iface_clk", "core_clk";
		qcom,infinite-mode = <0>;
		qcom,use-bam;
		qcom,use-pinctrl;
		qcom,ver-reg-exists;
		qcom,bam-consumer-pipe-index = <8>;
		qcom,bam-producer-pipe-index = <9>;
		qcom,master-id = <86>;
		status = "disabled";
	};
	spi_5: spi@7af5000 { /* BLSP2 QUP1 */
		compatible = "qcom,spi-qup-v2";
		#address-cells = <1>;
		#size-cells = <0>;
		reg-names = "spi_physical", "spi_bam_physical";
		reg = <0x7af5000 0x600>,
			<0x07AC4000 0x1f000>;
		interrupt-names = "spi_irq", "spi_bam_irq";
		interrupts = <0 299 0>, <0 239 0>;
		spi-max-frequency = <19200000>;
		pinctrl-names = "spi_default", "spi_sleep";
		pinctrl-0 = <&spi5_default &spi5_cs0_active>;
		pinctrl-1 = <&spi5_sleep &spi5_cs0_sleep>;
		clocks = <&clock_gcc clk_gcc_blsp2_ahb_clk>,
			<&clock_gcc clk_gcc_blsp2_qup1_spi_apps_clk>;
		clock-names = "iface_clk", "core_clk";
		qcom,infinite-mode = <0>;
		qcom,use-bam;
		qcom,use-pinctrl;
		qcom,ver-reg-exists;
		qcom,bam-consumer-pipe-index = <4>;
		qcom,bam-producer-pipe-index = <5>;
		qcom,master-id = <84>;
		status = "disabled";
	};
    spi_6: spi@7af6000 { /* BLSP2 QUP2 */
		compatible = "qcom,spi-qup-v2";
		#address-cells = <1>;
		#size-cells = <0>;
		reg-names = "spi_physical", "spi_bam_physical";
		reg = <0x7af6000 0x600>,
			<0x7ac4000 0x1f000>;
		interrupt-names = "spi_irq", "spi_bam_irq";
		interrupts = <0 300 0>, <0 239 0>;
		spi-max-frequency = <50000000>;
		pinctrl-names = "spi_default", "spi_sleep";
		pinctrl-0 = <&spi6_default &spi6_cs0_active>;
		pinctrl-1 = <&spi6_sleep &spi6_cs0_sleep>;
		clocks = <&clock_gcc clk_gcc_blsp2_ahb_clk>,
			<&clock_gcc clk_gcc_blsp2_qup2_spi_apps_clk>;
		clock-names = "iface_clk", "core_clk";
		qcom,infinite-mode = <0>;
		qcom,use-bam;
		qcom,use-pinctrl;
		qcom,ver-reg-exists;
		qcom,bam-consumer-pipe-index = <6>;
		qcom,bam-producer-pipe-index = <7>;
		qcom,master-id = <84>;
		status = "disabled";
	};
};

&soc {
	i2c@78b6000 {
		status = "okay";

		led_aw2013: aw2013@45 { /*blink */
			compatible = "awinic,aw2013-mi8953";
			reg = <0x45>;
			
			vdd-supply = <&pm8953_l10>;
			vcc-supply = <&pm8953_l5>;

			status = "disabled";

			AW2013_LED(white, 0)
		};
	};

	i2c@78b7000 {
		status = "okay";

        focaltech_ts: focaltech@38{
		    compatible = "focaltech,fts_ts-mi8953";
		    focaltech,ic-type = <>; // Unknown
		    reg = <0x38>;
		    interrupt-parent = <&tlmm>;
		    interrupts = <65 0x2008>;

            status = "disabled";

		    vdd-supply = <&pm8953_l10>;
		    vcc_i2c-supply = <&pm8953_l6>;
		    /* pins used by touchscreen */
                        pinctrl-names = "pmx_ts_active","pmx_ts_suspend",
                                                        "pmx_ts_release";
                        pinctrl-0 = <&ts_int_active &ts_reset_active>;
                        pinctrl-1 = <&ts_int_suspend &ts_reset_suspend>;
                        pinctrl-2 = <&ts_release>;
		    focaltech,reset-gpio = <&tlmm 64 0x00>;
		    focaltech,irq-gpio = <&tlmm 65 0x02>;
		    focaltech,max-touch-number = <10>;
	    };

		gt917d_ts: goodix@5d{
			compatible = "goodix,gt9xx";

			status = "disabled";

			reg = <0x5d>;
			interrupt-parent = <&tlmm>;
			interrupts = <65 0x2008>;

			vdd_ana-supply = <&pm8953_l10>;
			vcc_i2c-supply = <&pm8953_l6>;
			pinctrl-names = "gdix_ts_int_default", "gdix_ts_int_output_low",
				"gdix_ts_int_output_high", "gdix_ts_int_input",
				"gdix_ts_rst_default", "gdix_ts_rst_output_low",
				"gdix_ts_rst_output_high", "gdix_ts_rst_input";
			pinctrl-0 = <&ts_int_default>;
			pinctrl-1 = <&ts_int_output_low>;
			pinctrl-2 = <&ts_int_output_high>;
			pinctrl-3 = <&ts_int_input>;
			pinctrl-4 = <&ts_rst_default>;
			pinctrl-5 = <&ts_rst_output_low>;
			pinctrl-6 = <&ts_rst_output_high>;
			pinctrl-7 = <&ts_rst_input>;
			reset-gpios = <&tlmm 64 0x00>;
			irq-gpios = <&tlmm 65 0x2008>;
			irq-flags = <1>;
			touchscreen-max-id = <10>;
			goodix,type-a-report = <0>;
			goodix,driver-send-cfg = <1>;
			goodix,wakeup-with-reset = <0>;
			goodix,resume-in-workqueue = <1>;
			goodix,int-sync = <1>;
			goodix,swap-x2y = <0>;
			goodix,esd-protect = <1>;
			goodix,pen-suppress-finger = <0>;
			goodix,auto-update = <1>;
			goodix,auto-update-cfg = <0>;
			goodix,power-off-sleep = <0>;
			goodix,slide-wakeup = <1>;
		};

		gt9xx_ts: goodix_ts@14 {
			compatible = "goodix,gt9xx";
			reg = <0x14>;
			vdd_ana-supply = <&pm8953_l10>;
			vcc_i2c-supply = <&pm8953_l6>;

			interrupt-parent = <&tlmm>;
			interrupts = <65 0x2008>;

			status = "disabled";

			pinctrl-names = "gdix_ts_int_default", "gdix_ts_int_output_low",
				"gdix_ts_int_output_high", "gdix_ts_int_input",
				"gdix_ts_rst_default", "gdix_ts_rst_output_low",
				"gdix_ts_rst_output_high", "gdix_ts_rst_input";
			pinctrl-0 = <&ts_int_default>;
			pinctrl-1 = <&ts_int_output_low>;
			pinctrl-2 = <&ts_int_output_high>;
			pinctrl-3 = <&ts_int_input>;
			pinctrl-4 = <&ts_rst_default>;
			pinctrl-5 = <&ts_rst_output_low>;
			pinctrl-6 = <&ts_rst_output_high>;
			pinctrl-7 = <&ts_rst_input>;
			reset-gpios = <&tlmm 64 0x00>;
			irq-gpios = <&tlmm 65 0x2008>;
			irq-flags = <1>;
			touchscreen-max-id = <10>;
			goodix,type-a-report = <0>;
			goodix,driver-send-cfg = <1>;
			goodix,wakeup-with-reset = <0>;
			goodix,resume-in-workqueue = <1>;
			goodix,int-sync = <1>;
			goodix,swap-x2y = <0>;
			goodix,esd-protect = <1>;
			goodix,pen-suppress-finger = <0>;
			goodix,auto-update = <0>;
			goodix,auto-update-cfg = <0>;
			goodix,power-off-sleep = <0>;
			goodix,slide-wakeup = <1>;
			goodix,rst-gpio = <&tlmm 64 0x0>;
			goodix,irq-gpio = <&tlmm 65 0x2008>;

		};

		novatek_ts: novatek@62 {
			compatible = "novatek,NVT-ts_vince";
			reg = <0x62>;
			interrupt-parent = <&tlmm>;
			interrupts = <65 0x2008>;

            status = "disabled";

			novatek,reset-gpio = <&tlmm 64 0x0>;
			novatek,irq-gpio = <&tlmm 65 0x2001>;
		};
	};
};

&spi_5 {
	spidev_ir: spi_ir@1 {
	    compatible = "ifrared,spi-msm-ir-slave";
	    reg = <1>; /* Chip select 0 */
	    spi-max-frequency = <50000000>;
	    spi-cpol;
		status = "disabled";
	};
};

&spi_6 {
	spi_peel_ir: peel_ir@0 {
		compatible = "peel_ir";
		reg = <0x0>;
		spi-max-frequency = <19200000>;
		vdd-supply = <&pm8953_l8>; //vdd
		peel_ir,reg-id = "vdd";
		peel_ir,lr-gpio = <73>;
		peel_ir,lr-gpio-valid = <0>;
		peel_ir,spi-bpw = <32>;
		peel_ir,spi-clk-speed = <960000>;
		peel_ir,spi-mode = <0>;
		peel_ir,peel-field = <2345>;
		status = "disabled";
	};
};