&soc {
	goodix_fp {
		status = "okay";
		compatible = "goodix,fingerprint-vince";
		interrupt-parent = <&tlmm>;
		interrupts = <9 IRQ_TYPE_LEVEL_HIGH>;

		goodix,gpio_reset    = <&tlmm 140 0>;
		goodix,gpio_irq      = <&tlmm 48 0>;

	};

	fpc1020 {
		status = "okay";
		compatible = "fpc,fpc1020-mido";
		input-device-name = "fpc1020";
		interrupt-parent = <&tlmm>;
		interrupts = <9 IRQ_TYPE_LEVEL_HIGH>;
		fpc,gpio_rst    = <&tlmm 140 0>;
		fpc,gpio_irq    = <&tlmm 48 0>;

	};
};