#include "../common/sdhc.dtsi"
#include "../common/pinctrl.dtsi"
#include "display.dtsi"
#include "touchscreen.dtsi"
#include "camera.dtsi"
#include "battery.dtsi"
#include "audio.dtsi"
#include "misc.dtsi"
#include "pinctrl.dtsi"
#include "fingerprint.dtsi"
#include "pmic.dtsi"