&focaltech_ts {
	status = "okay";
	
	focaltech,alternate-i2c-addr = <0x40>;
	focaltech,key-y-coords = <2040 2040 2040>;
	focaltech,display-coords = <0 0 1080 1920>;
	focaltech,panel-coords = <0 0 1080 1920>;
	focaltech,have-key;
	focaltech,key-number = <3>;
	focaltech,keys = <172 139 158>;
	focaltech,key-x-coords = <500 200 800>;
	focaltech,ignore-id-check;
	focaltech,charger-detect;
};