/*
 * Copyright (c) 2015-2017, The Linux Foundation. All rights reserved.
 * Copyright (C) 2019 XiaoMi, Inc.
 *
 * This program is free software; you can redistribute it and/or modify
 * it under the terms of the GNU General Public License version 2 and
 * only version 2 as published by the Free Software Foundation.
 *
 * This program is distributed in the hope that it will be useful,
 * but WITHOUT ANY WARRANTY; without even the implied warranty of
 * MERCHANTABILITY or FITNESS FOR A PARTICULAR PURPOSE.  See the
 * GNU General Public License for more details.
 */

/* msm-audio */
&soc {
	i2c@78b6000 {
		status = "okay";
		spkamp@3a {/* max98927 smartpa device*/
			compatible = "maxim,max98927L";
			status = "okay";
			reg = <0x3a>;
			mono_stereo_mode = <0>;
			interleave_mode = <0>;
			vmon-l-slot = <1>;
			imon-l-slot = <1>;
			vmon-r-slot = <1>;
			imon-r-slot = <1>;
			maxim,98927-reset-gpio = <&tlmm 89 0>;
		};
	};
};