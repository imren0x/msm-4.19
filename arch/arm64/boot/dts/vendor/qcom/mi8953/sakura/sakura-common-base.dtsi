#include "../common/soc.dtsi"
#include "../common/spi.dtsi"
#include "../common/sdhc.dtsi"
#include "../common/audio.dtsi"
#include "../common/display.dtsi"
#include "../common/xiaomi-common.dtsi"
#include "../common/haptic.dtsi"
#include "../common/leds.dtsi"
#include "../common/misc.dtsi"
#include "sakura-common-pinctrl.dtsi"
#include "sakura-common-pm.dtsi"
#include "sakura-common-regulator.dtsi"
#include "sakura-common-audio.dtsi"
#include "sakura-common-mdss.dtsi"
#include "sakura-common-qrd.dtsi"
#include "sakura-common-camera.dtsi"
#include "sakura-common-general.dtsi"
