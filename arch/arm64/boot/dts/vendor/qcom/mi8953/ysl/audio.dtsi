/* msm-audio */

&int_codec {
	qcom,msm-hs-micbias-type = "external";

	qcom,msm-micbias1-ext-cap;
	qcom,msm-micbias2-ext-cap;
	//qcom,cdc-us-euro-gpios;
	qcom,msm-gpios =
		"pri_i2s",
		"comp_gpio";
	qcom,pinctrl-names =
		"all_off",
		"pri_i2s_act",
		"comp_gpio_act",
		"comp_gpio_pri_i2s_act";
	pinctrl-names =
		"all_off",
		"pri_i2s_act",
		"comp_gpio_act",
		"comp_gpio_pri_i2s_act";
	pinctrl-0 = <&cdc_pdm_lines_sus &cdc_pdm_comp_lines_sus
		&cdc_pdm_lines_2_sus>;
	pinctrl-1 = <&cdc_pdm_lines_act &cdc_pdm_comp_lines_sus
		&cdc_pdm_lines_2_act>;
	pinctrl-2 = <&cdc_pdm_lines_sus &cdc_pdm_comp_lines_act
		&cdc_pdm_lines_2_sus>;
	pinctrl-3 = <&cdc_pdm_lines_act &cdc_pdm_comp_lines_act
		&cdc_pdm_lines_2_act>;
	qcom,spk_ext_pa = <&tlmm 139 0x0>;
};