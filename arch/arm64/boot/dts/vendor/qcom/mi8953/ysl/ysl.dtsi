#include "../common/sdhc.dtsi"
#include "../common/pinctrl.dtsi"
#include "android.dtsi"
#include "pinctrl.dtsi"
#include "ysl-pinctrl.dtsi"
#include "pmic.dtsi"
#include "battery.dtsi"
#include "display.dtsi"
#include "touchscreen.dtsi"
#include "camera.dtsi"
#include "audio.dtsi"
#include "misc.dtsi"
#include "fingerprint.dtsi"