## techpack/xiaomi-msm8953/fingerprint/fpc/Kconfig
```kconfig
config FINGERPRINT_FPC1020
	tristate "FingerPrint Cards fingerprint driver support"
	help
	  Say Y here to enable fpc fingerprint driver support!
```

## techpack/xiaomi-msm8953/fingerprint/fpc_ysl/Kconfig
```kconfig
config FINGERPRINT_FPC
	tristate "FingerPrint Cards fingerprint drvier support"
	help
	  Say Y here to enable goodix fingerprint driver support!
```
