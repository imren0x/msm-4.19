## techpack/Kconfig
```kconfig
source "techpack/camera-legacy/Kconfig"
source "techpack/camera-legacy-n/Kconfig"
source "techpack/xiaomi-msm8953/Kconfig"
```

## techpack/xiaomi-msm8953/Kconfig
```kconfig
config MACH_XIAOMI_MSM8953
	bool "Support for Xiaomi MSM8953 platform"
	help
	  Say Y here to enable support for Xiaomi MSM8953 platform.

source "techpack/xiaomi-msm8953/mach/Kconfig"
source "techpack/xiaomi-msm8953/pmic/Kconfig"
source "techpack/xiaomi-msm8953/power_supply/Kconfig"
source "techpack/xiaomi-msm8953/touchscreen/Kconfig"
source "techpack/xiaomi-msm8953/leds/Kconfig"
source "techpack/xiaomi-msm8953/ir/Kconfig"
source "techpack/xiaomi-msm8953/fingerprint/Kconfig"
source "techpack/xiaomi-msm8953/vibrator/Kconfig"
```

## techpack/xiaomi-msm8953/fingerprint/Kconfig
```kconfig
source "techpack/xiaomi-msm8953/fingerprint/fpc/Kconfig"
source "techpack/xiaomi-msm8953/fingerprint/fpc_ysl/Kconfig"
source "techpack/xiaomi-msm8953/fingerprint/fpc_rosy/Kconfig"
source "techpack/xiaomi-msm8953/fingerprint/goodix/Kconfig"
source "techpack/xiaomi-msm8953/fingerprint/goodix_ysl/Kconfig"
source "techpack/xiaomi-msm8953/fingerprint/goodix_rosy/Kconfig"
source "techpack/xiaomi-msm8953/fingerprint/goodix_vince/Kconfig"

config FINGERPRINT_MI8953
 	bool "control interface for Xiaomi MSM8953 fingerprint"
 	help
 	  Say Y here to enable control interface for Xiaomi MSM8953 fingerprint
```

## techpack/xiaomi-msm8953/fingerprint/fpc_rosy/Kconfig
```kconfig
config FINGERPRINT_FPC1020_ROSY
	tristate "FPC1020 fingerprint driver"
	help
	  Say Y here to enable goodix fingerprint driver support!
```

## techpack/xiaomi-msm8953/fingerprint/goodix/Kconfig
```kconfig
config FINGERPRINT_GOODIX_GF3208
	tristate "goodix fingerprint gf3208 (mido)"
	help
	  Say Y here to enable goodix fingerprint driver support!
```

## techpack/xiaomi-msm8953/fingerprint/goodix_rosy/Kconfig
```kconfig
config FINGERPRINT_GF3208_ROSY
	tristate "GF3208 fingerprint driver"
	help
	  add support for goodix fingerprint driver.
```

## techpack/xiaomi-msm8953/fingerprint/goodix_vince/Kconfig
```kconfig
config FINGERPRINT_GOODIX_GF3208_VINCE
	tristate "goodix fingerprint gf3208 (vince)"
	help
	  Say Y here to enable goodix fingerprint driver support!
```

## techpack/xiaomi-msm8953/fingerprint/goodix_ysl/Kconfig
```kconfig
config GOODIX_FINGERPRINT
	tristate "goodix fingerprint gf3208 (ysl)"
	help
	    Say Y here to enable goodix fingerprint driver support!
```

## techpack/xiaomi-msm8953/ir/Kconfig
```kconfig
config SPI_PEELIR
	tristate "PEELIR"

	---help---
	   Enable this option if you use peelir.

config IR_PWM_MI8953
	tristate "PWM IR remote control"
	depends on RC_CORE
	---help---
	   Say Y if you want to use PWM based IR.

	   To compile this driver as a module, choose M here: the module will
	   be called pwm-ir.
```

## techpack/xiaomi-msm8953/leds/Kconfig
```kconfig
config LEDS_AW2013_MI8953
	tristate "LED support for AW2013"
	depends on LEDS_CLASS && I2C
	help
	  This option enables support for the AW2013 RGB LED connected
	  through I2C. Say Y to enable support for the AW2013 LED.
```

## techpack/xiaomi-msm8953/mach/Kconfig
```kconfig
# Machine families
config MACH_FAMILY_XIAOMI_MTP
	bool

config MACH_FAMILY_XIAOMI_QRD
	bool

config MACH_FAMILY_XIAOMI_QRD_SDM450
	bool
	depends on ARCH_SDM450
	select MACH_FAMILY_XIAOMI_QRD

config MACH_FAMILY_XIAOMI_QRD_MSM8953
	bool
	depends on ARCH_MSM8953
	select MACH_FAMILY_XIAOMI_QRD

# Machines
config MACH_XIAOMI_ROSY
	bool "Xiaomi Redmi 5 (rosy)"
	select MACH_FAMILY_XIAOMI_QRD_SDM450
	help
	  Support for Xiaomi Redmi 5 (rosy).

config MACH_XIAOMI_VINCE
	bool "Xiaomi Redmi 5 Plus (vince)"
	depends on ARCH_MSM8953
	select MACH_FAMILY_XIAOMI_QRD_MSM8953
	help
	  Support for Xiaomi Redmi 5 Plus (vince).

config MACH_XIAOMI_SAKURA
	bool "Xiaomi Redmi 6 Pro (sakura)"
	depends on ARCH_MSM8953
	select MACH_FAMILY_XIAOMI_QRD_MSM8953
	help
	  Support for Xiaomi Redmi 6 Pro (sakura).

config MACH_XIAOMI_TISSOT
	bool "Xiaomi Mi a1 (tissot)"
	depends on ARCH_MSM8953
	select MACH_FAMILY_XIAOMI_QRD_MSM8953
	help
	  Support for Xiaomi Mi a1 (tissot).

config MACH_XIAOMI_TIFFANY
	bool "Xiaomi Mi 5X (tiffany)"
	depends on ARCH_MSM8953
	select MACH_FAMILY_XIAOMI_QRD_MSM8953
	help
	  Support for Xiaomi Mi a1 (tissot).

config MACH_XIAOMI_MIDO
	bool "Xiaomi Redmi 4 (mido)"
	help
	  Support for Xiaomi Redmi 4 (mido).

config MACH_XIAOMI_MARKW
	bool "Xiaomi Redmi 4 (mido)"
	help
	  Support for Xiaomi Redmi 4 (mido).

config MACH_XIAOMI_YSL
	bool "Xiaomi Redmi S2 / Y2 (ysl)"
	depends on ARCH_MSM8953
	select MACH_FAMILY_XIAOMI_MTP
	help
	  Support for Xiaomi Redmi S2 / Y2 (ysl).

config SND_SOC_TAS2557
	bool  "Texas Audio TAS2557"
	help
	  Support for the Xiaomi Redmi 5 Plus platform.

config TAS2557_REGMAP
	bool  "Texas Audio TAS2557"
	help
	  Support for the Xiaomi Redmi 5 Plus platform.

config TAS2557_CODEC
	bool  "Texas Audio TAS2557"
	help
	  Support for the Xiaomi Redmi 5 Plus platform.

config TAS2557_MISC
	bool  "Texas Audio TAS2557"
	help
	  Support for the Xiaomi Redmi 5 Plus platform.
```

## techpack/xiaomi-msm8953/pmic/Kconfig
```kconfig
config LEDS_QPNP
	tristate "Support for QPNP LEDs"
	depends on LEDS_CLASS && SPMI
	help
	  This driver supports the LED functionality of Qualcomm Technologies,
	  Inc. QPNP PMICs.  It primarily supports controlling tri-color RGB
	  LEDs in both PWM and light pattern generator (LPG) modes.  For older
	  PMICs, it also supports WLEDs and flash LEDs.

config LEDS_QPNP_WLED
	tristate "Support for QPNP WLED"
	depends on LEDS_CLASS && MFD_SPMI_PMIC
	help
	  This driver supports the WLED (White LED) functionality of Qualcomm
	  Technologies, Inc. QPNP PMICs.  WLED is used for LCD backlight with
	  variable brightness.  It also supports outputting the Avdd supply for
	  AMOLED displays.
```

## techpack/xiaomi-msm8953/power_supply/qcom/Kconfig
```kconfig
config QPNP_TYPEC
	tristate "QPNP Type-C driver"
	depends on MFD_SPMI_PMIC
	help
	  Say Y here to enable QPNP Type-C driver.
	  The QPNP Type-C module supports the USB type-C protocol. It supports
	  type-C cable detection and other type-C parameters such as
	  current-capability and CC-orientation. The module does not support
	  USB power-delivery. The driver adds support to report these type-C
	  parameters via the power-supply framework.
```

## techpack/xiaomi-msm8953/touchscreen/Kconfig
```kconfig
source "techpack/xiaomi-msm8953/touchscreen/focaltech_touch/Kconfig"
source "techpack/xiaomi-msm8953/touchscreen/td4310_e7/Kconfig"
source "techpack/xiaomi-msm8953/touchscreen/td4310_lansi_e7/Kconfig"
source "techpack/xiaomi-msm8953/touchscreen/nt36xxx/Kconfig"
source "techpack/xiaomi-msm8953/touchscreen/gt9xx/Kconfig"

config TOUCHSCREEN_TD4310_E7
	tristate "synaptics touchscreens"
	depends on I2C
	help
	  Say Y here if you have a ist3038c touchscreen.
	  Ft5x06 controllers are multi touch controllers which can
	  report 5 touches at a time.

	  If unsure, say N.

	  To compile this driver as a module, choose M here: the
	  module will be called ist3038c_ts.

config TOUCHSCREEN_TD4310_LANSI_E7
	tristate "synaptics touchscreens"
	depends on I2C
	help
	  Say Y here if you have a ist3038c touchscreen.
	  Ft5x06 controllers are multi touch controllers which can
	  report 5 touches at a time.

	  If unsure, say N.

	  To compile this driver as a module, choose M here: the
	  module will be called ist3038c_ts.

config TOUCHSCREEN_IST3038C
	tristate "imagies touchscreens"
	depends on I2C
	help
	  Say Y here if you have a ist3038c touchscreen.
	  Ft5x06 controllers are multi touch controllers which can
	  report 5 touches at a time.

	  If unsure, say N.

	  To compile this driver as a module, choose M here: the
	  module will be called ist3038c_ts.

config TOUCHSCREEN_SYSCTL_MI8953
 	bool "Sysctl control interface for Xiaomi MSM8953 touchscreens"
 	help
 	  Say Y here to enable sysctl control interface for Xiaomi MSM8953 touchscreens
```

## techpack/xiaomi-msm8953/vibrator/Kconfig
```kconfig
config INPUT_QTI_HAPTICS_MI8953
 	tristate "Haptics support for QTI PMIC"
 	depends on MFD_SPMI_PMIC
 	help
 	  This option enables device driver support for the haptics peripheral
 	  found on Qualcomm Technologies, Inc. PMICs.  The haptics peripheral
 	  is capable of driving both LRA and ERM vibrators.  This module provides
 	  haptic feedback for user actions such as a long press on the touch screen.

config LEDS_QPNP_HAPTICS
	tristate "Haptics support for QPNP PMIC"
	depends on LEDS_CLASS && MFD_SPMI_PMIC
	help
	  This option enables device driver support for the haptics peripheral
	  found on Qualcomm Technologies, Inc. QPNP PMICs.  The haptic
	  peripheral is capable of driving both LRA and ERM vibrators.  This
	  module provides haptic feedback for user actions such as a long press
	  on the touch screen.
```
